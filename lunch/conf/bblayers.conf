## lunch/meta-burger/conf/layer.conf
```bitbake
BBPATH .= ":${LAYERDIR}"

BBFILES += "${LAYERDIR}/*.bb ${LAYERDIR}/*.bbappend"

BBFILE_COLLECTIONS += "burger"
BBFILE_PATTERN_burger := "^${LAYERDIR}/"
```

## zepto/meta-bash/conf/layer.conf
```bitbake
BBPATH .= ":${LAYERDIR}"

# BBFILES += "${LAYERDIR}/*.bb ${LAYERDIR}/*.bbappend"
BBFILES += "${LAYERDIR}/*.bb"
 
BBFILE_COLLECTIONS += "bash"
BBFILE_PATTERN_bash := "^${LAYERDIR}/"
```

## zepto/meta/conf/layer.conf
```bitbake
BBPATH .= ":${LAYERDIR}"

BBFILES += "${LAYERDIR}/*.bb"

BBFILE_COLLECTIONS += "core"
BBFILE_PATTERN_core := "^${LAYERDIR}/"
```
